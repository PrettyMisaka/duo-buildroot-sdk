## build/boards/cv181x/cv1813h_milkv_duos_sd/u-boot/cvitek_cv1813h_milkv_duos_sd_defconfig
```kconfig
CONFIG_RISCV=y
CONFIG_SYS_MALLOC_F_LEN=0x2000
CONFIG_NR_DRAM_BANKS=1
CONFIG_DEFAULT_DEVICE_TREE="cv181x_asic"
CONFIG_IDENT_STRING=" cvitek_cv181x"
CONFIG_ARCH_RV64I=y
CONFIG_RISCV_SMODE=y
CONFIG_TARGET_CVITEK_CV181X=y
CONFIG_DISTRO_DEFAULTS=y
CONFIG_FIT=y
# CONFIG_ARCH_FIXUP_FDT_MEMORY is not set
CONFIG_BOOTDELAY=1
CONFIG_SYS_PROMPT="cv181x_c906# "
# CONFIG_CMD_CONSOLE is not set
# CONFIG_CMD_XIMG is not set
# CONFIG_CMD_EDITENV is not set
# CONFIG_CMD_CRC32 is not set
# CONFIG_CMD_LZMADEC is not set
# CONFIG_CMD_UNLZ4 is not set
# CONFIG_CMD_UNZIP is not set
# CONFIG_CMD_LOADS is not set
CONFIG_CMD_MMC=y
# CONFIG_CMD_ITEST is not set
CONFIG_CMD_CACHE=y
CONFIG_CMD_CVI_SD_UPDATE=y
# CONFIG_ISO_PARTITION is not set
# CONFIG_EFI_PARTITION is not set
CONFIG_NET_RANDOM_ETHADDR=y
CONFIG_MMC=y
CONFIG_MMC_SDHCI=y
CONFIG_MMC_SDHCI_SDMA=y
CONFIG_MMC_SDHCI_CVITEK=y
CONFIG_MTD=y
# CONFIG_PHY_SMSC is not set
CONFIG_DM_ETH=y
CONFIG_ETH_DESIGNWARE=y
CONFIG_PHY_CVITEK=y
CONFIG_SYS_NS16550=y
CONFIG_SPI=y
CONFIG_LZ4=y
CONFIG_LZMA=y
# CONFIG_TOOLS_LIBCRYPTO is not set
CONFIG_ENV_IS_NOWHERE=y


#
# Compression commands
#
CONFIG_CMD_LZMADEC=y
# CONFIG_CMD_UNLZ4 is not set
CONFIG_CMD_UNZIP=y
CONFIG_CMD_ZIP=y

CONFIG_CMD_CONSOLE=y

#CONFIG_CMD_DATE=y
#CONFIG_CMD_TIME=y
#CONFIG_CMD_GETTIME=y
#CONFIG_CMD_SLEEP=y


#
# Debug commands
#
#CONFIG_CMD_BEDBUG=y
#CONFIG_CMD_DIAG=y
CONFIG_CMD_IRQ=y
CONFIG_CMD_LOG=y
#CONFIG_CMD_TRACE=y
# CONFIG_CMD_UBI is not set
CONFIG_CMD_CVI_JPEG=y
#CONFIG_CMD_CVISOUND=y
#CONFIG_CMD_CVI_UPDATE=y

CONFIG_BR2_STATIC_LIBS=y
CONFIG_BR2_PACKAGE_FFMPEG_ARCH_SUPPORTS=y
CONFIG_BR2_PACKAGE_FFMPEG=y
CONFIG_BR2_PACKAGE_FFMPEG_FFMPEG=y
CONFIG_BR2_PACKAGE_FFMPEG_ENCODERS=y
CONFIG_BR2_PACKAGE_FFMPEG_DECODERS=y
```
